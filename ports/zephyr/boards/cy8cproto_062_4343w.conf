## ports/zephyr/boards/nrf52840dk_nrf52840.conf
```kconfig
# Hardware features
CONFIG_I2C=y

# Sensors
CONFIG_SENSOR=y
CONFIG_DPS310=y

# Flash drivers
CONFIG_FLASH=y
CONFIG_FLASH_MAP=y
CONFIG_MPU_ALLOW_FLASH_WRITE=y

CONFIG_DISK_ACCESS=y
CONFIG_MICROPY_VFS_LFS2=y
CONFIG_NRF_RTC_TIMER=y
```
